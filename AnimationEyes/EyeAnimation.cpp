// ━━━━━━━━━━━━━━━━━━━━━━━━━━━━━━━━━━━━━━
// 🎨 EYE ANIMATION ENGINE IMPLEMENTATION
// ━━━━━━━━━━━━━━━━━━━━━━━━━━━━━━━━━━━━━━

#include "EyeAnimation.h"

// ━━━━━━━━━━━━━━━━━━━━
// � MOAI STONE BITMAP
// ━━━━━━━━━━━━━━━━━━━━
const unsigned char moai_bitmap[] PROGMEM = {
	0xff, 0xff, 0xff, 0xff, 0xff, 0xff, 0xff, 0xff, 0xff, 0xff, 0xff, 0xff, 0xff, 0xff, 0xff, 0xff, 
	0xff, 0xff, 0xff, 0xff, 0xff, 0xff, 0xff, 0xff, 0xff, 0xff, 0xff, 0xff, 0xff, 0xff, 0xff, 0xff, 
	0xff, 0xff, 0xff, 0xff, 0xff, 0xff, 0xff, 0xff, 0xff, 0xff, 0xff, 0xff, 0xff, 0xff, 0xff, 0xff, 
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	0xff, 0xff, 0xff, 0xff, 0xff, 0xff, 0xff, 0xff, 0xff, 0xff, 0xff, 0xff, 0xff, 0xff, 0xff, 0xff
};

#define MOAI_WIDTH 128
#define MOAI_HEIGHT 64

// ━━━━━━━━━━━━━━━━━━━━
// �🔧 CONSTRUCTOR
// ━━━━━━━━━━━━━━━━━━━━
EyeAnimation::EyeAnimation(Adafruit_SSD1306* disp, BuzzerFX* buz) 
  : display(disp), buzzer(buz) {}

void EyeAnimation::begin() {
  // Calculate initial eye positions
  eyeLx = screenWidth / 2 - 36 - 5 - 18;
  eyeLy = screenHeight / 2 - 18;
  eyeLxNext = eyeLx;
  eyeLyNext = eyeLy;
  
  eyeRx = eyeLx + 36 + 10;
  eyeRy = eyeLy;
  eyeRxNext = eyeRx;
  eyeRyNext = eyeRy;
  
  blinktimer = millis() + (blinkInterval * 1000);
  idleAnimationTimer = millis() + (idleInterval * 1000);
}

void EyeAnimation::update() {
  unsigned long now = millis();
  
  // Draw eyes (non-blocking)
  if (now - fpsTimer >= (unsigned long)frameInterval) {
    drawEyes();
    fpsTimer = now;
  }
}

// ━━━━━━━━━━━━━━━━━━━━
// 🔧 HELPER FUNCTIONS
// ━━━━━━━━━━━━━━━━━━━━

int EyeAnimation::getScreenConstraint_X() {
  return screenWidth - eyeLwidthCurrent - spaceBetweenCurrent - eyeRwidthCurrent;
}

int EyeAnimation::getScreenConstraint_Y() {
  return screenHeight - 36;
}

void EyeAnimation::setMood(unsigned char mood) {
  switch (mood) {
    case TIRED:
      tired = 1;
      angry = 0;
      happy = 0;
      break;
    case ANGRY:
      tired = 0;
      angry = 1;
      happy = 0;
      break;
    case HAPPY:
      tired = 0;
      angry = 0;
      happy = 1;
      break;
    default:
      tired = 0;
      angry = 0;
      happy = 0;
      break;
  }
}

void EyeAnimation::setPosition(unsigned char position) {
  switch (position) {
    case 1:  // N
      eyeLxNext = getScreenConstraint_X() / 2;
      eyeLyNext = 0;
      break;
    case 5:  // S
      eyeLxNext = getScreenConstraint_X() / 2;
      eyeLyNext = getScreenConstraint_Y();
      break;
    default:  // DEFAULT (center)
      eyeLxNext = getScreenConstraint_X() / 2;
      eyeLyNext = getScreenConstraint_Y() / 2;
      break;
  }
}

void EyeAnimation::close() {
  eyeLheightNext = 1;
  eyeRheightNext = 1;
  eyeL_open = 0;
  eyeR_open = 0;
}

void EyeAnimation::open() {
  eyeL_open = 1;
  eyeR_open = 1;
}

void EyeAnimation::blink() {
  close();
  open();
}

void EyeAnimation::wink() {
  eyeRheightNext = 1;
  eyeR_open = 0;
  delay(10);
  eyeR_open = 1;
}

void EyeAnimation::anim_confused() {
  confused = 1;
}

void EyeAnimation::anim_laugh() {
  laugh = 1;
}

void EyeAnimation::drawEyes() {
  // Curious mode offset
  if (curious) {
    if (eyeLxNext <= 10) {
      eyeLheightOffset = 8;
    } else {
      eyeLheightOffset = 0;
    }
    if (eyeRxNext >= screenWidth - eyeRwidthCurrent - 10) {
      eyeRheightOffset = 8;
    } else {
      eyeRheightOffset = 0;
    }
  } else {
    eyeLheightOffset = 0;
    eyeRheightOffset = 0;
  }
  
  // Height tweening
  eyeLheightCurrent = (eyeLheightCurrent + eyeLheightNext + eyeLheightOffset) / 2;
  eyeLy += ((36 - eyeLheightCurrent) / 2);
  eyeLy -= eyeLheightOffset / 2;
  
  eyeRheightCurrent = (eyeRheightCurrent + eyeRheightNext + eyeRheightOffset) / 2;
  eyeRy += (36 - eyeRheightCurrent) / 2;
  eyeRy -= eyeRheightOffset / 2;
  
  // Open eyes after closing
  if (eyeL_open) {
    if (eyeLheightCurrent <= 1 + eyeLheightOffset) {
      eyeLheightNext = 36;
    }
  }
  if (eyeR_open) {
    if (eyeRheightCurrent <= 1 + eyeRheightOffset) {
      eyeRheightNext = 36;
    }
  }
  
  // Width tweening
  eyeLwidthCurrent = (eyeLwidthCurrent + eyeLwidthNext) / 2;
  eyeRwidthCurrent = (eyeRwidthCurrent + eyeRwidthNext) / 2;
  
  // Space tweening
  spaceBetweenCurrent = (spaceBetweenCurrent + spaceBetweenNext) / 2;
  
  // Position tweening
  eyeLx = (eyeLx + eyeLxNext) / 2;
  eyeLy = (eyeLy + eyeLyNext) / 2;
  
  eyeRxNext = eyeLxNext + eyeLwidthCurrent + spaceBetweenCurrent;
  eyeRyNext = eyeLyNext;
  eyeRx = (eyeRx + eyeRxNext) / 2;
  eyeRy = (eyeRy + eyeRyNext) / 2;
  
  // Border radius tweening
  eyeLborderRadiusCurrent = (eyeLborderRadiusCurrent + eyeLborderRadiusNext) / 2;
  eyeRborderRadiusCurrent = (eyeRborderRadiusCurrent + eyeRborderRadiusNext) / 2;
  
  // Auto blink
  if (autoblinker) {
    if (millis() >= blinktimer) {
      blink();
      blinktimer = millis() + (blinkInterval * 1000) + (random(blinkIntervalVariation) * 1000);
    }
  }
  
  // Laugh animation
  if (laugh) {
    if (laughToggle) {
      vFlicker = 1;
      vFlickerAmplitude = 5;
      laughAnimationTimer = millis();
      laughToggle = 0;
    } else if (millis() >= laughAnimationTimer + laughAnimationDuration) {
      vFlicker = 0;
      laughToggle = 1;
      laugh = 0;
    }
  }
  
  // Confused animation
  if (confused) {
    if (confusedToggle) {
      hFlicker = 1;
      hFlickerAmplitude = 20;
      confusedAnimationTimer = millis();
      confusedToggle = 0;
    } else if (millis() >= confusedAnimationTimer + confusedAnimationDuration) {
      hFlicker = 0;
      confusedToggle = 1;
      confused = 0;
    }
  }
  
  // Idle animation
  if (idle) {
    if (millis() >= idleAnimationTimer) {
      eyeLxNext = random(getScreenConstraint_X());
      eyeLyNext = random(getScreenConstraint_Y());
      idleAnimationTimer = millis() + (idleInterval * 1000) + (random(idleIntervalVariation) * 1000);
    }
  }
  
  // Horizontal flicker
  if (hFlicker) {
    if (hFlickerAlternate) {
      eyeLx += hFlickerAmplitude;
      eyeRx += hFlickerAmplitude;
    } else {
      eyeLx -= hFlickerAmplitude;
      eyeRx -= hFlickerAmplitude;
    }
    hFlickerAlternate = !hFlickerAlternate;
  }
  
  // Vertical flicker
  if (vFlicker) {
    if (vFlickerAlternate) {
      eyeLy += vFlickerAmplitude;
      eyeRy += vFlickerAmplitude;
    } else {
      eyeLy -= vFlickerAmplitude;
      eyeRy -= vFlickerAmplitude;
    }
    vFlickerAlternate = !vFlickerAlternate;
  }
  
  // ━━━━━━━━━━━━━━━━━━━━
  // 🎨 ACTUAL DRAWING
  // ━━━━━━━━━━━━━━━━━━━━
  display->clearDisplay();
  
  // Check if stone mode - draw moai face
  if (stoneMode) {
    drawStone();
  }
  // Check if love mode - draw hearts instead of eyes
  else if (loveMode) {
    drawHeart(eyeLx + eyeLwidthCurrent/2 - 12, eyeLy + eyeLheightCurrent/2 - 10, 24);
    drawHeart(eyeRx + eyeRwidthCurrent/2 - 12, eyeRy + eyeRheightCurrent/2 - 10, 24);
  } 
  else {
    // Draw normal eyes
    display->fillRoundRect(eyeLx, eyeLy, eyeLwidthCurrent, eyeLheightCurrent, eyeLborderRadiusCurrent, MAINCOLOR);
    display->fillRoundRect(eyeRx, eyeRy, eyeRwidthCurrent, eyeRheightCurrent, eyeRborderRadiusCurrent, MAINCOLOR);
  }
  
  // Mood eyelids (skip if love mode)
  if (!loveMode && !stoneMode) {
    if (tired) {
      eyelidsTiredHeightNext = eyeLheightCurrent / 2;
      eyelidsAngryHeightNext = 0;
    } else {
      eyelidsTiredHeightNext = 0;
    }
    
    if (angry) {
      eyelidsAngryHeightNext = eyeLheightCurrent / 2;
      eyelidsTiredHeightNext = 0;
    } else {
      eyelidsAngryHeightNext = 0;
    }
    
    if (happy) {
      eyelidsHappyBottomOffsetNext = eyeLheightCurrent / 2;
    } else {
      eyelidsHappyBottomOffsetNext = 0;
    }
    
    // Draw tired eyelids
    eyelidsTiredHeight = (eyelidsTiredHeight + eyelidsTiredHeightNext) / 2;
    display->fillTriangle(eyeLx, eyeLy - 1, eyeLx + eyeLwidthCurrent, eyeLy - 1, eyeLx, eyeLy + eyelidsTiredHeight - 1, BGCOLOR);
    display->fillTriangle(eyeRx, eyeRy - 1, eyeRx + eyeRwidthCurrent, eyeRy - 1, eyeRx + eyeRwidthCurrent, eyeRy + eyelidsTiredHeight - 1, BGCOLOR);
    
    // Draw angry eyelids
    eyelidsAngryHeight = (eyelidsAngryHeight + eyelidsAngryHeightNext) / 2;
    display->fillTriangle(eyeLx, eyeLy - 1, eyeLx + eyeLwidthCurrent, eyeLy - 1, eyeLx + eyeLwidthCurrent, eyeLy + eyelidsAngryHeight - 1, BGCOLOR);
    display->fillTriangle(eyeRx, eyeRy - 1, eyeRx + eyeRwidthCurrent, eyeRy - 1, eyeRx, eyeRy + eyelidsAngryHeight - 1, BGCOLOR);
    
    // Draw happy eyelids
    eyelidsHappyBottomOffset = (eyelidsHappyBottomOffset + eyelidsHappyBottomOffsetNext) / 2;
    display->fillRoundRect(eyeLx - 1, (eyeLy + eyeLheightCurrent) - eyelidsHappyBottomOffset + 1, eyeLwidthCurrent + 2, 36, eyeLborderRadiusCurrent, BGCOLOR);
    display->fillRoundRect(eyeRx - 1, (eyeRy + eyeRheightCurrent) - eyelidsHappyBottomOffset + 1, eyeRwidthCurrent + 2, 36, eyeRborderRadiusCurrent, BGCOLOR);
  }
  
  display->display();
}

// Draw heart shape for love expression
void EyeAnimation::drawHeart(int x, int y, int size) {
  // Heart is made of two circles and a triangle
  int halfSize = size / 2;
  int quarterSize = size / 4;
  
  // Top two circles
  display->fillCircle(x + quarterSize, y + quarterSize, quarterSize, MAINCOLOR);
  display->fillCircle(x + halfSize + quarterSize, y + quarterSize, quarterSize, MAINCOLOR);
  
  // Bottom triangle (point down)
  display->fillTriangle(
    x, y + quarterSize,
    x + size, y + quarterSize,
    x + halfSize, y + size,
    MAINCOLOR
  );
}

// Draw moai stone face 🗿
void EyeAnimation::drawStone() {
  // Draw the moai bitmap centered on screen
  display->drawBitmap(0, 0, moai_bitmap, MOAI_WIDTH, MOAI_HEIGHT, MAINCOLOR);
}

// ━━━━━━━━━━━━━━━━━━━━
// 🎭 EXPRESSION FUNCTIONS
// ━━━━━━━━━━━━━━━━━━━━

void EyeAnimation::expr_idle() {
  Serial.println("😐 Idle");
  setMood(DEFAULT);
  loveMode = 0;
  stoneMode = 0;
  autoblinker = 1;
  idle = 1;
  buzzer->play(SOUND_TICK);
}

void EyeAnimation::expr_happy() {
  Serial.println("😊 Happy");
  setMood(HAPPY);
  loveMode = 0;
  autoblinker = 1;
  idle = 0;
  setPosition(DEFAULT);
  buzzer->play(SOUND_HAPPY);
}

void EyeAnimation::expr_laugh() {
  Serial.println("😂 Laugh");
  setMood(HAPPY);
  loveMode = 0;
  autoblinker = 0;
  idle = 0;
  anim_laugh();
  buzzer->play(SOUND_LAUGH);
}

void EyeAnimation::expr_sad() {
  Serial.println("😢 Sad");
  setMood(TIRED);
  loveMode = 0;
  autoblinker = 1;
  idle = 0;
  setPosition(DEFAULT);
  buzzer->play(SOUND_SAD);
}

void EyeAnimation::expr_angry() {
  Serial.println("😡 Angry");
  setMood(ANGRY);
  loveMode = 0;
  stoneMode = 0;
  autoblinker = 0;
  idle = 0;
  setPosition(DEFAULT);
  buzzer->play(SOUND_ANGRY);
}

void EyeAnimation::expr_thinking() {
  Serial.println("🤔 Thinking");
  setMood(DEFAULT);
  autoblinker = 1;
  idle = 0;
  buzzer->play(SOUND_THINKING);
}

void EyeAnimation::expr_cool() {
  Serial.println("😎 Cool");
  setMood(DEFAULT);
  eyeLheightNext = 18;
  eyeRheightNext = 18;
  autoblinker = 0;
  idle = 0;
  buzzer->play(SOUND_COOL);
}

void EyeAnimation::expr_shock() {
  Serial.println("😱 Shock");
  setMood(DEFAULT);
  loveMode = 0;
  stoneMode = 0;
  eyeLwidthNext = 46;
  eyeLheightNext = 46;
  eyeRwidthNext = 46;
  eyeRheightNext = 46;
  autoblinker = 0;
  idle = 0;
  buzzer->play(SOUND_SHOCK);
}

void EyeAnimation::expr_confused() {
  Serial.println("😕 Confused");
  setMood(DEFAULT);
  autoblinker = 0;
  idle = 0;
  anim_confused();
  buzzer->play(SOUND_LAUGH);
}

void EyeAnimation::expr_clown() {
  Serial.println("🤡 Clown");
  setMood(HAPPY);
  autoblinker = 0;
  idle = 0;
  buzzer->play(SOUND_CLOWN);
}

void EyeAnimation::expr_stone() {
  Serial.println("🗿 STONE MODE - SILENT & STATIC");
  setMood(DEFAULT);
  loveMode = 0;
  stoneMode = 1;
  autoblinker = 0;
  idle = 0;
  confused = 0;
  laugh = 0;
  eyeLxNext = getScreenConstraint_X() / 2;
  eyeLyNext = getScreenConstraint_Y() / 2;
  buzzer->stop();
  buzzer->mute();
}

void EyeAnimation::expr_normal() {
  Serial.println("😐 Normal");
  setMood(DEFAULT);
  autoblinker = 1;
  idle = 1;
  buzzer->unmute();
}

void EyeAnimation::expr_sleepy() {
  Serial.println("😴 Sleepy");
  setMood(TIRED);
  eyeLheightNext = 12;
  eyeRheightNext = 12;
  autoblinker = 1;
  idle = 0;
  setPosition(DEFAULT);
  buzzer->play(SOUND_SAD);
}

void EyeAnimation::expr_love() {
  Serial.println("😍 Love");
  setMood(DEFAULT);
  loveMode = 1;  // Enable heart drawing
  eyeLwidthNext = 30;
  eyeLheightNext = 30;
  eyeRwidthNext = 30;
  eyeRheightNext = 30;
  autoblinker = 0;  // Don't blink hearts
  idle = 0;
  setPosition(DEFAULT);
  buzzer->play(SOUND_HAPPY);
}

void EyeAnimation::expr_wink() {
  Serial.println("😉 Wink");
  setMood(DEFAULT);
  autoblinker = 0;
  idle = 0;
  wink();
  buzzer->play(SOUND_TICK);
}

void EyeAnimation::expr_dizzy() {
  Serial.println("😵 Dizzy");
  setMood(DEFAULT);
  eyeLwidthNext = 32;
  eyeLheightNext = 32;
  eyeRwidthNext = 32;
  eyeRheightNext = 32;
  spaceBetweenNext = 20;
  autoblinker = 0;
  idle = 0;
  anim_confused();
  buzzer->play(SOUND_SHOCK);
}

void EyeAnimation::expr_bored() {
  Serial.println("😑 Bored");
  setMood(TIRED);
  eyeLheightNext = 20;
  eyeRheightNext = 20;
  autoblinker = 1;
  idle = 1;
  buzzer->play(SOUND_THINKING);
}
